## meta-rootfs-enc-core/conf/layer.conf
```bitbake
#
# meta-rootfs-enc-core/conf/layer.conf
#
# Root filesystem encryption layer configuration (core/base)
#
# Copyright (c) 1983-2026 Advantech Co., Ltd. All rights reserved.
#

BBPATH .= ":${LAYERDIR}"
BBFILES += "${LAYERDIR}/recipes-*/*/*.bb \
            ${LAYERDIR}/recipes-*/*/*.bbappend"
BBFILE_COLLECTIONS += "meta-rootfs-enc-core"
BBFILE_PATTERN_meta-rootfs-enc-core = "^${LAYERDIR}/"
BBFILE_PRIORITY_meta-rootfs-enc-core = "10"
LAYERVERSION_meta-rootfs-enc-core = "1"
LAYERSERIES_COMPAT_meta-rootfs-enc-core = "scarthgap styhead walnascar whinlatter wrynose blacksail"
```

## meta-rootfs-enc-nxp/conf/layer.conf
```bitbake
#
# meta-rootfs-enc-nxp/conf/layer.conf
#
# Root filesystem encryption layer configuration for i.MX NXP systems
#
# Copyright (c) 1983-2026 Advantech Co., Ltd. All rights reserved.
#

BBPATH .= ":${LAYERDIR}"
BBFILES += "${LAYERDIR}/recipes-*/*/*.bb \
            ${LAYERDIR}/recipes-*/*/*.bbappend"
BBFILE_COLLECTIONS += "meta-rootfs-enc-nxp"
BBFILE_PATTERN_meta-rootfs-enc-nxp = "^${LAYERDIR}/"
BBFILE_PRIORITY_meta-rootfs-enc-nxp = "10"
LAYERVERSION_meta-rootfs-enc-nxp = "1"
LAYERDEPENDS_meta-rootfs-enc-nxp = "meta-secure-boot-nxp meta-rootfs-enc-core"
LAYERSERIES_COMPAT_meta-rootfs-enc-nxp = "scarthgap styhead walnascar whinlatter wrynose blacksail"

# For Yocto <= 5.3:
WKS_SEARCH_PATH:prepend := "${LAYERDIR}/files/wic:"
```

## meta-secure-boot-nxp/conf/layer.conf
```bitbake
#
# meta-secure-boot-nxp/conf/layer.conf
#
# Secure Boot layer for i.MX NXP systems
#
# Copyright (c) 1983-2026 Advantech Co., Ltd. All rights reserved.
#

BBPATH .= ":${LAYERDIR}"
BBFILES += "${LAYERDIR}/recipes-*/*/*.bb \
            ${LAYERDIR}/recipes-*/*/*.bbappend"
BBFILE_COLLECTIONS += "meta-secure-boot-nxp"
BBFILE_PATTERN_meta-secure-boot-nxp = "^${LAYERDIR}/"
BBFILE_PRIORITY_meta-secure-boot-nxp = "9"
LAYERVERSION_meta-secure-boot-nxp = "1"
LAYERSERIES_COMPAT_meta-secure-boot-nxp = "scarthgap styhead walnascar whinlatter wrynose blacksail"
```
